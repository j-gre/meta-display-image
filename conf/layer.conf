## conf/layer.conf
```bitbake
include conf/machine/verdin-imx8mm-extra.conf

# Add the conf and classes directory to BBPATH
BBPATH .= ":${LAYERDIR}"

# Add all recipes-* directories to BBFILES
BBFILES += "${LAYERDIR}/recipes-*/*/*.bb \
            ${LAYERDIR}/recipes-*/*/*.bbappend"

BBFILE_COLLECTIONS += "meta-display-image"
BBFILE_PATTERN_meta-display-image = "^${LAYERDIR}/"
BBFILE_PRIORITY_meta-display-image = "6"

#Set the minimal layer to depend on
LAYERDEPENDS_meta-display-image = "core"
# Seth the reference distribution
LAYERSERIES_COMPAT_meta-display-image = "dunfell"
```

## conf/machine/verdin-imx8mm-extra.conf
```bitbake
KERNEL_DEVICETREE_append = "verdin-imx8mm_am4001280_overlay.dtb"
MACHINE_EXTRA_RDEPENDS += "di-load-driver"
# Appears not to have any impact on the driver, no autoload occurs (EPROBE DEFER), use systemd to force load the driver via modprobe
KERNEL_MODULE_AUTOLOAD += "am4001280atzqw00h_driver"
```
